# file: CMSISbasis.ioc
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Mcu.Family=STM32F1
Mcu.Name=STM32F103C(8-B)Tx
Mcu.Package=LQFP48
NVIC.PriorityGroup=NVIC_PRIORITYGROUP_4
ProjectManager.HeapSize=0x200
ProjectManager.StackSize=0x400
ProjectManager.TargetToolchain=STM32CubeIDE
RCC.APB1Freq_Value=8000000
RCC.APB2Freq_Value=8000000
board=custom

// file: Core/Src/main.c
/* USER CODE BEGIN Header */
/**
  ******************************************************************************
  * @file           : main.c
  * @brief          : Main program body
  ******************************************************************************
  * @attention
  *
  * Copyright (c) 2023 STMicroelectronics.
  * All rights reserved.
  *
  * This software is licensed under terms that can be found in the LICENSE file
  * in the root directory of this software component.
  * If no LICENSE file comes with this software, it is provided AS-IS.
  *
  ******************************************************************************
  */
/* USER CODE END Header */
#include "main.h"

/* USER CODE BEGIN Includes */
#include <stdint.h>
/* USER CODE END Includes */

void SystemClock_Config(void);

/* USER CODE BEGIN 0 */
void delay_ms(volatile uint16_t delay)
{
	//Carefull!!! Timer 4 in only 16 bits!
	TIM4->PSC = SystemCoreClock/1000000-1; //set Timer prescaler register
	TIM4->ARR = delay; //Set Timer Auto-reload register
	TIM4->EGR |= TIM_EGR_UG; // Set UG bit in EGR register to update upcounting mode
	TIM4->CR1 |= TIM_CR1_CEN|TIM_CR1_OPM; //Set one Pulse Mode (OPM) and enable the counter
	while((TIM4->CR1)&(TIM_CR1_CEN!=0)); //Check the counter enable bit - It clears automatically in one pulse mode
}
/* USER CODE END 0 */

int main(void)
{
  /* USER CODE BEGIN 1 */
	uint8_t btn_k0;
	//uint16_t tmpreg = 0x00U;
  /* USER CODE END 1 */

  /* MCU Configuration--------------------------------------------------------*/

  /* Reset of all peripherals, Initializes the Flash interface and the Systick. */
  HAL_Init();

  /* Configure the system clock */
  SystemClock_Config();

  /* Initialize all configured peripherals */
  /* USER CODE BEGIN 2 */

  RCC->APB2ENR |= (RCC_APB2ENR_IOPBEN|RCC_APB2ENR_IOPAEN); // Enable APB2 Clock Port A and F
  //RCC->APB1ENR |= RCC_APB1ENR_TIM4EN; //Delay Timer initialization
  SET_BIT(RCC->APB1ENR, RCC_APB1ENR_TIM4EN);

  GPIOA->CRL &= 0xFFFFFFF4; //PortA-0 as input
  //GPIOA->ODR |= 0x00000001; //PortA-0 Pull-up

  GPIOB->CRH &= 0xFFFFFFFF0; //PortB-8 as output - GP push pull and max speed 10MHz
  SET_BIT(GPIOB->CRH, GPIO_CRH_MODE8_0);

  GPIOB->BSRR = 1<<8; // Set PortB-8 to 1 (led off)
  //GPIOB->BSRR = GPIO_BSRR_BS8;

  /* USER CODE END 2 */

  /* Infinite loop */
  while (1)
  {

    /* USER CODE BEGIN 3 */
	 btn_k0 = ((GPIOA->IDR & 0x01));

	 if(btn_k0 == 0) //If swithc K0 pressed)
	 {
		GPIOB->BSRR =  1<<24; // Reset pin PortB-8 (Led on)
		delay_ms(2000000);
		GPIOB->BSRR =  1<<8; // Set pin PortB-8 (Led off)
		//delay_ms(2000000);
	 }

  }
  /* USER CODE END 3 */
}

void SystemClock_Config(void)
{
  RCC_OscInitTypeDef RCC_OscInitStruct = {0};
  RCC_ClkInitTypeDef RCC_ClkInitStruct = {0};

  /** Initializes the RCC Oscillators according to the specified parameters
  * in the RCC_OscInitTypeDef structure.
  */
  RCC_OscInitStruct.OscillatorType = RCC_OSCILLATORTYPE_HSI;
  RCC_OscInitStruct.HSIState = RCC_HSI_ON;
  RCC_OscInitStruct.HSICalibrationValue = RCC_HSICALIBRATION_DEFAULT;
  RCC_OscInitStruct.PLL.PLLState = RCC_PLL_NONE;
  if (HAL_RCC_OscConfig(&RCC_OscInitStruct) != HAL_OK)
  {
    Error_Handler();
  }

  /** Initializes the CPU, AHB and APB buses clocks
  */
  RCC_ClkInitStruct.ClockType = RCC_CLOCKTYPE_HCLK|RCC_CLOCKTYPE_SYSCLK
                              |RCC_CLOCKTYPE_PCLK1|RCC_CLOCKTYPE_PCLK2;
  RCC_ClkInitStruct.SYSCLKSource = RCC_SYSCLKSOURCE_HSI;
  RCC_ClkInitStruct.AHBCLKDivider = RCC_SYSCLK_DIV1;
  RCC_ClkInitStruct.APB1CLKDivider = RCC_HCLK_DIV1;
  RCC_ClkInitStruct.APB2CLKDivider = RCC_HCLK_DIV1;

  if (HAL_RCC_ClockConfig(&RCC_ClkInitStruct, FLASH_LATENCY_0) != HAL_OK)
  {
    Error_Handler();
  }
}

void Error_Handler(void)
{
  __disable_irq();
  while (1)
  {
  }
}
